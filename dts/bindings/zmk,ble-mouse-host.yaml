## dts/bindings/zmk,ble-mouse-host.yaml
```yaml
# Copyright (c) 2026 Tadashi Kadowaki
# SPDX-License-Identifier: MIT

description: |
  Virtual input device representing an external BLE mouse connected to this
  keyboard over BLE HID (central / HID-over-GATT host). Pointer events received
  from the mouse are emitted as Zephyr input events from this device, so a
  zmk,input-listener bound to it forwards them to the active output.

compatible: "zmk,ble-mouse-host"

properties:
  pair-name-prefix:
    type: string
    description: |
      Fresh pairing (mouse_pair) connects to the first device whose advertised
      local name (complete or shortened, in the advertisement or its scan
      response) starts with this string, whatever its GAP appearance. Needed for
      ZMK devices, which advertise the Keyboard appearance (0x03C1). Pick a
      prefix that does not match this keyboard's own name or its split halves.
      If unset, pairing matches the HID Mouse appearance (0x03C2) instead.
  wheel-invert-usb:
    type: boolean
    description: |
      Invert the forwarded mouse's scroll-wheel direction while the USB endpoint
      is active. Applied automatically on every output-endpoint change.
  wheel-invert-ble-profiles:
    type: array
    description: |
      BLE profile indices (0-based) whose scroll-wheel direction is inverted,
      e.g. <0 1>. Profiles not listed stay normal. Applied automatically on every
      output-endpoint change (and after a reboot, when the saved profile
      reconnects), so the direction tracks the target device.
```
